## arch/arm/hotplug/Kconfig
```kconfig
config ALUCARD_HOTPLUG
        bool "Enable alucard cpu hotplug driver"
        default n
        help
          Generic alucard_hotplug cpu hotplug driver for ARM SOCs

config BRICKED_HOTPLUG
 	bool "Enable kernel based mpdecision"
 	depends on MSM_RUN_QUEUE_STATS
 	default y
 	help
 	  This enables kernel based multi core control.
 	  (up/down hotplug based on load)
```
